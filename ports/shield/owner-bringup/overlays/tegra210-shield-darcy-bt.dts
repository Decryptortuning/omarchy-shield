/dts-v1/;
/plugin/;
/ {
 fragment@0 { target-path = "/serial@70006300"; __overlay__ { status = "okay"; }; };
 fragment@1 { target-path = "/serial@70006300/bluetooth"; __overlay__ { max-speed = <3000000>; }; };
};
